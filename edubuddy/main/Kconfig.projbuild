## main/Kconfig.projbuild
```kconfig
menu "Edubuddy Assistant"

config OTA_URL
    string "Default OTA URL"
    default ""
    help
        The application will access this URL to check for new firmwares and server address.

choice CONNECTION_TYPE
    prompt "Connection Type"
    default CONNECTION_TYPE_MQTT_UDP
    help
        Select communication protocol with server
    
    config CONNECTION_TYPE_MQTT_UDP
        bool "MQTT + UDP"
        help
            Use MQTT for control messages and UDP for audio streaming
    
    config CONNECTION_TYPE_WEBSOCKET
        bool "WebSocket"
        help
            Use WebSocket for all communication including audio
endchoice

config MQTT_BROKER_URL
    string "MQTT Broker URL"
    default ""
    depends on CONNECTION_TYPE_MQTT_UDP
    help
        MQTT broker URL for control messages

config MQTT_ACCESS_TOKEN
    string "MQTT Access Token"
    default ""
    depends on CONNECTION_TYPE_MQTT_UDP
    help
        Access token for MQTT authentication

config UDP_AUDIO_SERVER
    string "UDP Audio Server"
    default ""
    depends on CONNECTION_TYPE_MQTT_UDP
    help
        UDP server address for audio streaming (format: IP:PORT)

config WEBSOCKET_URL
    string "WebSocket Server URL"
    default ""
    depends on CONNECTION_TYPE_WEBSOCKET
    help
        WebSocket server URL (ws://10.191.29.238:8000/xiaozhi/v1/)

config WEBSOCKET_ACCESS_TOKEN
    string "WebSocket Access Token"
    default ""
    depends on CONNECTION_TYPE_WEBSOCKET
    help
        Access token for WebSocket authentication

config WEBSOCKET_RECONNECT_INTERVAL_MS
    int "WebSocket Reconnect Interval (ms)"
    default 5000
    range 1000 30000
    depends on CONNECTION_TYPE_WEBSOCKET
    help
        Time to wait before attempting to reconnect in milliseconds

choice
    prompt "Flash Assets"
    default FLASH_DEFAULT_ASSETS
    help
        Select the assets to flash.

    config FLASH_NONE_ASSETS
        bool "Do not flash assets"
    config FLASH_DEFAULT_ASSETS
        bool "Flash Default Assets"
    config FLASH_CUSTOM_ASSETS
        bool "Flash Custom Assets"
endchoice

config CUSTOM_ASSETS_FILE
    depends on FLASH_CUSTOM_ASSETS
    string "Custom Assets File"
    default "assets.bin"
    help
        The custom assets file to flash.
        It can be a local file relative to the project directory or a remote url.

choice
    prompt "Default Language"
    default LANGUAGE_ID_ID
    help
        Select device display language

    config LANGUAGE_EN_US
        bool "English"
    config LANGUAGE_ID_ID
        bool "Indonesian"
    config LANGUAGE_MS_MY
        bool "Malay"
endchoice

choice BOARD_TYPE
    prompt "Board Type"
    default BOARD_TYPE_BREAD_COMPACT_WIFI_LCD
    help
        Board type selection.
    config BOARD_TYPE_BREAD_COMPACT_WIFI_LCD
        bool "Bread Compact WiFi + LCD"
        depends on IDF_TARGET_ESP32S3
    config BOARD_TYPE_BREAD_COMPACT_WIFI_CAM
        bool "Bread Compact WiFi + LCD + Camera"
        depends on IDF_TARGET_ESP32S3
endchoice

choice DISPLAY_LCD_TYPE
    depends on BOARD_TYPE_BREAD_COMPACT_WIFI_LCD || BOARD_TYPE_BREAD_COMPACT_WIFI_CAM
    prompt "LCD Type"
    default LCD_ST7789_240X320
    help
        LCD Display Type
    config LCD_ST7789_240X320
        bool "ST7789 240*320, IPS"
    config LCD_ST7789_240X320_NO_IPS
        bool "ST7789 240*320, Non-IPS"
    config LCD_ST7789_170X320
        bool "ST7789 170*320"
    config LCD_ST7789_172X320
        bool "ST7789 172*320"
    config LCD_ST7789_240X280
        bool "ST7789 240*280"
    config LCD_ST7789_240X240
        bool "ST7789 240*240"
    config LCD_ST7789_240X240_7PIN
        bool "ST7789 240*240, 7PIN"
    config LCD_ST7789_240X135
        bool "ST7789 240*135"
    config LCD_ST7735_128X160
        bool "ST7735 128*160"
    config LCD_ST7735_128X128
        bool "ST7735 128*128"
    config LCD_ST7796_320X480
        bool "ST7796 320*480 IPS"
    config LCD_ST7796_320X480_NO_IPS
        bool "ST7796 320*480, Non-IPS"
    config LCD_ILI9341_240X320
        bool "ILI9341 240*320"
    config LCD_ILI9341_240X320_NO_IPS
        bool "ILI9341 240*320, Non-IPS"
    config LCD_GC9A01_240X240
        bool "GC9A01 240*240 Circle"
endchoice

choice DISPLAY_STYLE
    prompt "Select display style"
    default USE_DEFAULT_MESSAGE_STYLE
    help
        Select display style for Edubuddy device

    config USE_DEFAULT_MESSAGE_STYLE
        bool "Enable default message style"
    config USE_WECHAT_MESSAGE_STYLE
        bool "Enable WhatsApp Message Style"
endchoice

choice WAKE_WORD_TYPE
    prompt "Wake Word Implementation Type"
    default USE_AFE_WAKE_WORD if (IDF_TARGET_ESP32S3 || IDF_TARGET_ESP32P4) && SPIRAM
    default WAKE_WORD_DISABLED
    help
        Choose the type of wake word implementation to use

    config WAKE_WORD_DISABLED
        bool "Disabled"
        help
            Disable wake word detection

    config USE_ESP_WAKE_WORD
        bool "Wakenet model without AFE"
        depends on IDF_TARGET_ESP32C3 || IDF_TARGET_ESP32C5 || IDF_TARGET_ESP32C6 || (IDF_TARGET_ESP32 && SPIRAM)
        help
            Support ESP32 C3、ESP32 C5 与 ESP32 C6, and (ESP32 with PSRAM)

    config USE_AFE_WAKE_WORD
        bool "Wakenet model with AFE"
        depends on (IDF_TARGET_ESP32S3 || IDF_TARGET_ESP32P4) && SPIRAM
        help
            Support AEC if available, requires ESP32 S3 and PSRAM

    config USE_CUSTOM_WAKE_WORD
        bool "Multinet model (Custom Wake Word)"
        depends on (IDF_TARGET_ESP32S3 || IDF_TARGET_ESP32P4) && SPIRAM
        help
            Requires ESP32 S3 and PSRAM
endchoice

config CUSTOM_WAKE_WORD
    string "Custom Wake Word"
    default "edubuddy"
    depends on USE_CUSTOM_WAKE_WORD
    help
        Custom Wake Word, use pinyin for Chinese, separated by spaces

config CUSTOM_WAKE_WORD_DISPLAY
    string "Custom Wake Word Display"
    default "Edubuddy"
    depends on USE_CUSTOM_WAKE_WORD
    help
        Greeting sent to the server after wake word detection

config CUSTOM_WAKE_WORD_THRESHOLD
    int "Custom Wake Word Threshold (%)"
    default 20
    range 1 99
    depends on USE_CUSTOM_WAKE_WORD
    help
        Custom Wake Word Threshold, range 1-99, the smaller the more sensitive, default 20

config SEND_WAKE_WORD_DATA
    bool "Send Wake Word Data"
    default y
    depends on USE_AFE_WAKE_WORD || USE_CUSTOM_WAKE_WORD
    help
        Send wake word data to the server as the first message of the conversation and wait for response

config USE_AUDIO_PROCESSOR
    bool "Enable Audio Noise Reduction"
    default y
    depends on (IDF_TARGET_ESP32S3 || IDF_TARGET_ESP32P4) && SPIRAM
    help
        Requires ESP32 S3 and PSRAM

config USE_DEVICE_AEC
    bool "Enable Device-Side AEC"
    default n
    depends on USE_AUDIO_PROCESSOR && (BOARD_TYPE_BREAD_COMPACT_WIFI_LCD || BOARD_TYPE_BREAD_COMPACT_WIFI_CAM)
    help
        To work properly, device-side AEC requires a clean output reference path from the speaker signal and physical acoustic isolation between the microphone and speaker.

config USE_SERVER_AEC
    bool "Enable Server-Side AEC (Unstable)"
    default n
    depends on USE_AUDIO_PROCESSOR
    help
        To work properly, server-side AEC requires server support

config USE_AUDIO_DEBUGGER
    bool "Enable Audio Debugger"
    default n
    help
        Enable audio debugger, send audio data through UDP to the host machine

config AUDIO_DEBUG_UDP_SERVER
    string "Audio Debug UDP Server Address"
    default "192.168.2.100:8000"
    depends on USE_AUDIO_DEBUGGER
    help
        UDP server address, format: IP:PORT, used to receive audio debugging data

menu "WiFi Configuration Method"
    help
        WiFi Configuration Method Selection
    config USE_HOTSPOT_WIFI_PROVISIONING
        bool "Hotspot"
        default y
        help
            Use WiFi Hotspot to transmit WiFi configuration data
    config USE_ACOUSTIC_WIFI_PROVISIONING
        bool "Acoustic"
        help
            Use audio signal to transmit WiFi configuration data

    config USE_ESP_BLUFI_WIFI_PROVISIONING
        bool "Esp Blufi"
        help
            Use esp blufi protocol to transmit WiFi configuration data
        select BT_ENABLED
        select BT_BLE_42_FEATURES_SUPPORTED
        select BT_BLE_BLUFI_ENABLE
        select MBEDTLS_DHM_C
endmenu

config RECEIVE_CUSTOM_MESSAGE
    bool "Enable Custom Message Reception"
    default n
    help
        Enable custom message reception, allow the device to receive custom messages from the server

menu "Camera Configuration"
    depends on !IDF_TARGET_ESP32 && BOARD_TYPE_BREAD_COMPACT_WIFI_CAM

    comment "Warning: Please read the help text before modifying these settings."

    config XIAOZHI_CAMERA_ALLOW_JPEG_INPUT
        bool "Allow JPEG Input"
        default n
        help
            Allow JPEG Input format for the camera.
            This option may need to be enabled when using a USB camera.
            Not currently supported when used simultaneously with XIAOZHI_ENABLE_ROTATE_CAMERA_IMAGE.

    config XIAOZHI_ENABLE_HARDWARE_JPEG_ENCODER
        bool "Enable Hardware JPEG Encoder"
        default y
        depends on SOC_JPEG_ENCODE_SUPPORTED
        help
            Use hardware JPEG encoder on ESP32-P4 to encode image to JPEG.
            See https://docs.espressif.com/projects/esp-idf/en/stable/esp32p4/api-reference/peripherals/jpeg.html for more details.

    config XIAOZHI_ENABLE_HARDWARE_JPEG_DECODER
        bool "Enable Hardware JPEG Decoder"
        default n
        depends on SOC_JPEG_DECODE_SUPPORTED && XIAOZHI_CAMERA_ALLOW_JPEG_INPUT
        help
            Use hardware JPEG decoder on ESP32-P4 to decode JPEG to image.
            See https://docs.espressif.com/projects/esp-idf/en/stable/esp32p4/api-reference/peripherals/jpeg.html for more details.

    config XIAOZHI_ENABLE_CAMERA_DEBUG_MODE
        bool "Enable Camera Debug Mode"
        default n
        help
            Enable camera debug mode, print camera debug information to the console.
            Only works on boards that support camera.

    config XIAOZHI_ENABLE_CAMERA_ENDIANNESS_SWAP
        bool "Enable software camera buffer endianness swapping"
        default n
        depends on !CAMERA_SENSOR_SWAP_PIXEL_BYTE_ORDER
        help
            This option treats the camera buffer as a uint16_t[] array and performs byte-swapping (endianness conversion) on each element.
            Should only be modified by development board integration engineers.
            **Incorrect usage may result in incorrect image colors!**
            ATTENTION: If the option CAMERA_SENSOR_SWAP_PIXEL_BYTE_ORDER is available for your sensor, please use that instead.

    menuconfig XIAOZHI_ENABLE_ROTATE_CAMERA_IMAGE
        bool "Enable Camera Image Rotation"
        default n
        depends on !XIAOZHI_CAMERA_ALLOW_JPEG_INPUT
        help
            Enable camera image rotation, rotate the camera image to the correct orientation.
            - On ESP32-P4, rotation is handled by PPA hardware.
            - On other chips, rotation is done in software with performance cost.
            - For 180° rotation, use HFlip + VFlip instead of this option.
            Not currently supported when used simultaneously with XIAOZHI_CAMERA_ALLOW_JPEG_INPUT.

    if XIAOZHI_ENABLE_ROTATE_CAMERA_IMAGE
        choice CAMERA_IMAGE_ROTATION_ANGLE
            prompt "Camera Image Rotation Angle (clockwise)"
            default XIAOZHI_CAMERA_IMAGE_ROTATION_ANGLE_90
            help
                Camera image rotation angle.
            config XIAOZHI_CAMERA_IMAGE_ROTATION_ANGLE_90
                bool "90°"
            config XIAOZHI_CAMERA_IMAGE_ROTATION_ANGLE_270
                bool "270°"
            comment "For 180° rotation, use HFlip + VFlip instead of this option"
        endchoice
    endif
endmenu

menu "WebSocket Configuration"
    depends on CONNECTION_TYPE_WEBSOCKET
    help
        Advanced WebSocket configuration options

    config EDUBUDDY_WEBSOCKET_RX_BUFFER_SIZE
        int "Receive Buffer Size (bytes)"
        default 4096
        range 1024 16384
        help
            Size of WebSocket receive buffer

    config EDUBUDDY_WEBSOCKET_TX_BUFFER_SIZE
        int "Transmit Buffer Size (bytes)"
        default 4096
        range 1024 16384
        help
            Size of WebSocket transmit buffer

    config EDUBUDDY_WEBSOCKET_SSL_VERIFY
        bool "Enable SSL Certificate Verification"
        default y
        help
            Verify SSL certificate for secure WebSocket connections

    config EDUBUDDY_WEBSOCKET_FRAGMENTATION
        bool "Enable Message Fragmentation"
        default n
        help
            Enable fragmentation of large messages

    config EDUBUDDY_WEBSOCKET_MAX_FRAGMENT_SIZE
        int "Maximum Fragment Size (bytes)"
        default 1024
        range 256 8192
        depends on EDUBUDDY_WEBSOCKET_FRAGMENTATION
        help
            Maximum size of each fragment when fragmenting messages

    config EDUBUDDY_WEBSOCKET_TASK_STACK_SIZE
        int "Task Stack Size (bytes)"
        default 8192
        range 4096 32768
        help
            Stack size for WebSocket event handler task

    config EDUBUDDY_WEBSOCKET_LOG_LEVEL
        int "Debug Log Level (0-5)"
        default 3
        range 0 5
        help
            Log level for WebSocket debugging (0=None, 1=Error, 2=Warning, 3=Info, 4=Debug, 5=Verbose)

    config EDUBUDDY_WEBSOCKET_AUTO_PONG
        bool "Auto-Response to Ping"
        default y
        help
            Automatically respond to WebSocket ping messages

    config EDUBUDDY_WEBSOCKET_CUSTOM_HEADERS
        bool "Enable Custom Headers"
        default n
        help
            Enable sending custom headers during WebSocket handshake
endmenu

menu "MQTT Configuration"
    depends on CONNECTION_TYPE_MQTT_UDP
    help
        Advanced MQTT configuration options

    config EDUBUDDY_MQTT_CLIENT_ID
        string "Client ID"
        default ""
        help
            MQTT client ID (if empty, will use device MAC address)

    config EDUBUDDY_MQTT_QOS_LEVEL
        int "Quality of Service (0-2)"
        default 1
        range 0 2
        help
            MQTT Quality of Service level (0=At most once, 1=At least once, 2=Exactly once)

    config EDUBUDDY_MQTT_KEEPALIVE_TIME
        int "Keepalive Interval (seconds)"
        default 120
        range 30 900
        help
            MQTT keepalive interval in seconds

    config EDUBUDDY_MQTT_CLEAN_SESSION
        bool "Clean Session"
        default y
        help
            Start with a clean session (true) or resume previous session (false)

    config EDUBUDDY_MQTT_RECONNECT_DELAY_MS
        int "Reconnect Interval (ms)"
        default 5000
        range 1000 30000
        help
            Time to wait before attempting to reconnect in milliseconds

    config EDUBUDDY_MQTT_MSG_BUFFER_SIZE
        int "Message Buffer Size (bytes)"
        default 4096
        range 1024 16384
        help
            Size of MQTT send/receive buffer

    config EDUBUDDY_MQTT_TOPIC_PREFIX
        string "Topic Prefix"
        default "edubuddy"
        help
            Prefix for all MQTT topics
endmenu

config EDUBUDDY_DEBUG_MODE
    bool "Enable Debug Mode"
    default n
    help
        Enable debug mode with additional logging and diagnostics

config EDUBUDDY_SERIAL_CONSOLE
    bool "Enable Serial Console"
    default y
    help
        Enable serial console for debugging and configuration

config EDUBUDDY_SERIAL_BAUD_RATE
    int "Serial Baud Rate"
    default 115200
    range 9600 921600
    depends on EDUBUDDY_SERIAL_CONSOLE
    help
        Baud rate for serial console communication

endmenu
```
